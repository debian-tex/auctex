## debian/auctex/config.in
```kconfig
#include "variables"
#! /bin/bash -e
#
# <% config %> script for <:=${PACKAGE}:>
#
<:=@COPYRIGHT:>//

set -o posix

source <:=${CONFMODULE}:>
db_version 2.0

case "${1}" in
    (configure|reconfigure)
    LOGFILE=$(mktemp <:=${TMPMASK}:>)
    db_register <:=${PACKAGE}:>/doauto <:=${PACKAGE}:>/logfile || true
    db_set <:=${PACKAGE}:>/logfile ${LOGFILE} || true
    db_subst <:=${PACKAGE}:>/doauto LOGFILE ${LOGFILE} || true
    db_subst <:=${PACKAGE}:>/doautofg LOGFILE ${LOGFILE} || true
    db_input low <:=${PACKAGE}:>/doauto || true
    db_go || true
    db_get <:=${PACKAGE}:>/doauto || true
    if [ "${RET}" = "Foreground" ]; then
	<:# Ask another time the user, if she really wants to shoot :>//
	<:# her very feet.  Just to be sure. :>//
	db_input low <:=${PACKAGE}:>/doautofg || true
	db_go || true
    fi
    ;;
    (*) echo >&2 "${0##*/}/<:=${PACKAGE}:>:" \
	"Unknown argument: \"${1}\"."
    ;;
esac

exit 0
<:
# arch-tag: 0c222277-b851-436c-912e-b5c8e4468867
#
# local variables:
# mode: shell-script
# coding: utf-8
# ispell-local-dictionary: "american"
# ispell-check-comments: exclusive
# end:
:>//
```

## debian/config.in
```kconfig
#include "variables"
#!/bin/bash -e
#
# config configuration file for Debian <:=${PACKAGE}:> package.
# $Id: config.in,v 1.12 2004/05/19 09:27:14 salve Exp $
#
<:=@COPYRIGHT:>//

set -o posix

source <:=${CONFMODULE}:>
db_version 2.0

case "${1}" in
    (configure|reconfigure)
    if egrep "\brequire[[:space:]]+[^)]*'tex-site\b" <:=${SSEL}:> \
	| egrep -v ";.*\brequire\b" &>/dev/null; then
	db_set <:=${PACKAGE}:>/default false || true
	db_text low <:=${PACKAGE}:>/alreadydefault || true
    else
	db_input medium <:=${PACKAGE}:>/default || true
    fi
    db_go || true
    LOGFILE=$(mktemp <:=${TMPMASK}:>)
    db_register <:=${PACKAGE}:>/doauto <:=${PACKAGE}:>/logfile || true
    db_set <:=${PACKAGE}:>/logfile ${LOGFILE} || true
    db_subst <:=${PACKAGE}:>/doauto LOGFILE ${LOGFILE} || true
    db_subst <:=${PACKAGE}:>/doautofg LOGFILE ${LOGFILE} || true
    db_input low <:=${PACKAGE}:>/doauto || true
    db_go || true
    db_get <:=${PACKAGE}:>/doauto || true
    if [ "${RET}" = "Foreground" ]; then
	<:# Ask another time the user, if she really wants to shoot:>//
	<:# herself in the foot.  Just to be sure.:>//
	db_input low <:=${PACKAGE}:>/doautofg || true
	db_go || true
    fi ;;
    (*) echo >&2 "${0##*/}: Called with unknown argument \`${1}'." ;;
esac

exit 0
<:
# Local Variables:
# mode: shell-script
# End:
:>//
```
